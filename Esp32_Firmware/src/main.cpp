#include <Arduino.h>
#include <NimBLEDevice.h>
#include <Wire.h>
#include <Adafruit_GFX.h>
#include <Adafruit_SSD1306.h>

#define SCREEN_WIDTH 128
#define SCREEN_HEIGHT 64

#define OLED_SDA 21
#define OLED_SCL 22
#define BUTTON_PIN 15

Adafruit_SSD1306 display(SCREEN_WIDTH, SCREEN_HEIGHT, &Wire, -1);

// BLE UUIDs
#define SERVICE_UUID        "12345678-1234-1234-1234-123456789012"
#define CHARACTERISTIC_UUID "87654321-4321-4321-4321-210987654321"

// STATES
bool phoneConnected = false;
bool eyeMode = false;

// NAV DATA
String directionText = "--";
String distanceText = "--";
String instructionText = "--";
int marqueeWidth = 0;

int scrollX = 128;
unsigned long lastScroll = 0;

// BUTTON
bool lastButtonState = HIGH;

// EYES
const int eyeWidth = 22;
const int eyeHeight = 32;
const int eyeGap = 20;

int eyeBaseLeftX = 38;
int eyeBaseRightX = eyeBaseLeftX + eyeWidth + eyeGap;

int eyeXOffset = 0;
int eyeYOffset = 0;

unsigned long lastMove = 0;
unsigned long lastBlink = 0;
unsigned long blinkInterval = 3000;

//honda Bitmap
const unsigned char epd_bitmap_HNDAlogo_design[] PROGMEM = {
0xff, 0xff, 0xff, 0xff, 0xff, 0xff, 0xff, 0xff, 0xff, 0xff, 0xff, 0xff, 0xff, 0xff, 0xff, 0xff, 
	0xff, 0xff, 0xff, 0xff, 0xff, 0xff, 0xff, 0xff, 0xff, 0xff, 0xff, 0xff, 0xff, 0xff, 0xff, 0xff, 
	0xff, 0xff, 0xff, 0xff, 0xff, 0xff, 0xff, 0xff, 0xff, 0xff, 0xff, 0xff, 0xff, 0xff, 0xff, 0xff, 
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	0xff, 0xff, 0xff, 0xff, 0xff, 0xff, 0xff, 0xff, 0xff, 0xff, 0xff, 0xff, 0xff, 0xff, 0xff, 0xff
};
//bit map for poster cb350rs 
const unsigned char epd_bitmap_elytra_design[] PROGMEM = {
0xff, 0xff, 0xff, 0xff, 0xff, 0xff, 0xff, 0xff, 0xff, 0xff, 0xff, 0xff, 0xff, 0xff, 0xff, 0xff, 
	0xff, 0xff, 0xff, 0xff, 0xff, 0xff, 0xff, 0xff, 0xff, 0xff, 0xff, 0xff, 0xff, 0xff, 0xff, 0xff, 
	0xff, 0xff, 0xff, 0xff, 0xff, 0xff, 0xff, 0xff, 0xff, 0xff, 0xff, 0xff, 0xff, 0xff, 0xff, 0xff, 
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	0xff, 0xff, 0xff, 0xff, 0xff, 0xff, 0xff, 0xff, 0xff, 0xff, 0xff, 0xff, 0xff, 0xff, 0xff, 0xff
};

//honda welcomeScreen
void showWelcomeScreen() {
  display.clearDisplay();

  display.drawBitmap(
    0,                          // X
    0,                          // Y
    epd_bitmap_HNDAlogo_design, // bitmap
    128,                        // width
    64,                         // height
    WHITE
  );

  display.display();

  delay(1500);

  display.clearDisplay();

  display.drawBitmap(
    0,                          // X
    0,                          // Y
    epd_bitmap_elytra_design, // bitmap
    128,                        // width
    64,                         // height
    WHITE
  );

  display.display();

  delay(1500);
}

// STARTUP SCREEN
void showStartupScreen() {
  display.clearDisplay();
  display.setTextColor(WHITE);

  display.setTextSize(2);
  display.setCursor(20, 18);
  display.println("BIKENAV");

  display.setTextSize(1);
  display.setCursor(32, 45);
  display.println("v1.0 alpha");

  display.display();
}

// NAV SCREEN
void showNavScreen() {

  display.clearDisplay();
  display.setTextColor(WHITE);

  int16_t x1, y1;
  uint16_t w, h;

  // ===== BIG TOP SECTION =====
  display.setTextSize(2);

  // Direction
  display.getTextBounds(directionText, 0, 0, &x1, &y1, &w, &h);
  display.setCursor((128 - w) / 2, 2);
  display.print(directionText);

  // Distance
  display.getTextBounds(distanceText, 0, 0, &x1, &y1, &w, &h);
  display.setCursor((128 - w) / 2, 24);
  display.print(distanceText);

  // Divider
  display.drawLine(0, 50, 128, 50, WHITE);

  // Footer clean strip
  display.fillRect(0, 51, 128, 13, BLACK);

  // ===== SMOOTH SINGLE-LINE TICKER =====
  const int charWidth = 6;
  const int visibleChars = 22;
  String marquee = instructionText + "          ";   // 10 spaces gap

  // smooth update
  if (millis() - lastScroll > 20) {
    scrollX++;
    lastScroll = millis();
  }

  int startChar = scrollX / charWidth;

  // reset only after full sentence + gap fully passes
  if (startChar > marquee.length() + visibleChars) {
    scrollX = 0;
    startChar = 0;
  }

  String visible = "";

  for (int i = 0; i < visibleChars; i++) {
    int idx = startChar - visibleChars + i;

    if (idx >= 0 && idx < marquee.length()) {
      visible += marquee.charAt(idx);
    } else {
      visible += ' ';
    }
  }

  display.setTextSize(1);
  display.setCursor(0, 56);
  display.print(visible);

  display.display();
}
// DRAW EYES
void drawEyes() {
  display.clearDisplay();

  int leftEyeX = eyeBaseLeftX + eyeXOffset;
  int rightEyeX = eyeBaseRightX + eyeXOffset;
  int eyeY = 18 + eyeYOffset;

  display.fillRoundRect(leftEyeX, eyeY, eyeWidth, eyeHeight, 4, WHITE);
  display.fillRoundRect(rightEyeX, eyeY, eyeWidth, eyeHeight, 4, WHITE);

  display.display();
}

// BLINK
void blinkEyes() {
  display.clearDisplay();

  int leftEyeX = eyeBaseLeftX + eyeXOffset;
  int rightEyeX = eyeBaseRightX + eyeXOffset;
  int eyeY = 18 + eyeYOffset;

  display.fillRoundRect(leftEyeX, eyeY + 12, eyeWidth, 4, 4, WHITE);
  display.fillRoundRect(rightEyeX, eyeY + 12, eyeWidth, 4, 4, WHITE);

  display.display();

  delay(120);

  drawEyes();
}

// RANDOM MOVEMENT
void randomEyeMovement() {
  eyeXOffset = random(-12, 16);
  eyeYOffset = random(-3, 4);
  drawEyes();
}

// BLE SERVER CALLBACK
class ServerCallbacks : public NimBLEServerCallbacks {

  void onConnect(NimBLEServer* pServer, NimBLEConnInfo& connInfo) override {
    phoneConnected = true;
    Serial.println("Phone Connected");
  }

  void onDisconnect(
    NimBLEServer* pServer,
    NimBLEConnInfo& connInfo,
    int reason
  ) override {

    phoneConnected = false;
    // directionText = "--";
    directionText = "--";
distanceText = "--";
instructionText = "--";

    Serial.println("Phone Disconnected");

    NimBLEDevice::startAdvertising();
  }
};

// BLE DATA CALLBACK
class MyCallbacks : public NimBLECharacteristicCallbacks {

void onWrite(
  NimBLECharacteristic* pChar,
  NimBLEConnInfo& connInfo
) override {

  String data = String(pChar->getValue().c_str());

  Serial.println("RAW: " + data);

  int separator = data.indexOf('|');

  if (separator == -1) return;

  directionText = data.substring(0, separator);

  String payload = data.substring(separator + 1);

  // Extract distance (e.g. "195 m")
  int firstSpace = payload.indexOf(' ');
  int secondSpace = payload.indexOf(' ', firstSpace + 1);

  if (firstSpace != -1 && secondSpace != -1) {
    distanceText = payload.substring(0, secondSpace);
    instructionText = payload.substring(secondSpace + 1);
  } else {
    distanceText = "--";
    instructionText = payload;
  }

  // Clean text
  instructionText.replace("\n", " ");
  instructionText.replace("\r", " ");
  instructionText.trim();

  if (directionText == "") directionText = "--";
  if (distanceText == "") distanceText = "--";
  if (instructionText == "") instructionText = "--";

  // restart ticker from beginning
  scrollX = 0;
}
};

void setup() {
  Serial.begin(115200);

  Wire.begin(OLED_SDA, OLED_SCL);
  pinMode(BUTTON_PIN, INPUT_PULLUP);

  if (!display.begin(SSD1306_SWITCHCAPVCC, 0x3C)) {
    while (true); 
  }

  randomSeed(analogRead(0));

  // BLE INIT
  NimBLEDevice::init("BikeNav");
  NimBLEDevice::setMTU(247);

  NimBLEServer* server = NimBLEDevice::createServer();
  server->setCallbacks(new ServerCallbacks());

  NimBLEService* service = server->createService(SERVICE_UUID);

  NimBLECharacteristic* characteristic =
    service->createCharacteristic(
      CHARACTERISTIC_UUID,
      NIMBLE_PROPERTY::WRITE |
      NIMBLE_PROPERTY::WRITE_NR
    );

  characteristic->setCallbacks(new MyCallbacks());

  NimBLEAdvertising* advertising = NimBLEDevice::getAdvertising();
  advertising->addServiceUUID(SERVICE_UUID);
  advertising->start();

  Serial.println("BLE READY");

  showWelcomeScreen();
  // delay(2000);
}

void loop() {

  // BUTTON TOGGLE
  bool currentButtonState = digitalRead(BUTTON_PIN);

  if (lastButtonState == HIGH &&
      currentButtonState == LOW) {

    eyeMode = !eyeMode;
    delay(200);
  }

  lastButtonState = currentButtonState;

  // EYE MODE
  if (eyeMode) {

    if (millis() - lastMove > 700) {
      randomEyeMovement();
      lastMove = millis();
    }

    if (millis() - lastBlink > blinkInterval) {
      blinkEyes();
      blinkInterval = random(2000, 6000);
      lastBlink = millis();
    }

  } else {

    if (!phoneConnected) {
      showStartupScreen();
    } else {
      showNavScreen();
    }
  }
}